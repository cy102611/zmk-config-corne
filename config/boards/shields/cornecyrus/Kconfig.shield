## config/boards/shields/cornecyrus/Kconfig.shield
```kconfig
config SHIELD_CORNECYRUS_LEFT
    def_bool $(shields_list_contains,cornecyrus_left)

config SHIELD_CORNECYRUS_RIGHT
    def_bool $(shields_list_contains,cornecyrus_right)
```
